## main/Kconfig.projbuild
```kconfig
menu "ESP32 Pi Configuration"

config ENABLE_LED
bool "Blink LED to show worker task usage"
default "y"

config LED_PIN
int "GPIO number connecting LED"
depends on ENABLE_LED
range 0 33
default 2

config SUPPRESS_PI_DIGITS
bool "Suppress Pi digits"
default "y"

endmenu
```

## sdkconfig.defaults
```kconfig
# Override some defaults
CONFIG_ESP32_DEFAULT_CPU_FREQ_240=y
CONFIG_ESP32_DEFAULT_CPU_FREQ_MHZ=240
CONFIG_COMPILER_OPTIMIZATION_LEVEL_RELEASE=y
CONFIG_ESP_TASK_WDT_CHECK_IDLE_TASK_CPU0=
CONFIG_ESP_TASK_WDT_CHECK_IDLE_TASK_CPU1=
#
```
